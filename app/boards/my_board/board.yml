## app/boards/my_board/board.yml
```yaml
board:
  name: my_board
  full_name: MY BOARD
  vendor: st
  socs:
    - name: stm32f401xe
```

## app/boards/our_board/board.yml
```yaml
board:
  name: our_board
  full_name: OUR BOARD
  vendor: st
  socs:
    - name: stm32f401xe
```

## twister-out.1/stm32f4_disco_stm32f407xx/zephyr_gnu/tests/ring_buf/homework.unit.ring_buf/Kconfig/arch/Kconfig
```kconfig
# Load Zephyr Arch Kconfig descriptions.
osource "/home/sweekar/Projects/zephyr-demo/zephyr-course/zephyr/arch/rx/Kconfig"
osource "/home/sweekar/Projects/zephyr-demo/zephyr-course/zephyr/arch/x86/Kconfig"
osource "/home/sweekar/Projects/zephyr-demo/zephyr-course/zephyr/arch/xtensa/Kconfig"
osource "/home/sweekar/Projects/zephyr-demo/zephyr-course/zephyr/arch/sparc/Kconfig"
osource "/home/sweekar/Projects/zephyr-demo/zephyr-course/zephyr/arch/riscv/Kconfig"
osource "/home/sweekar/Projects/zephyr-demo/zephyr-course/zephyr/arch/posix/Kconfig"
osource "/home/sweekar/Projects/zephyr-demo/zephyr-course/zephyr/arch/openrisc/Kconfig"
osource "/home/sweekar/Projects/zephyr-demo/zephyr-course/zephyr/arch/mips/Kconfig"
osource "/home/sweekar/Projects/zephyr-demo/zephyr-course/zephyr/arch/arm64/Kconfig"
osource "/home/sweekar/Projects/zephyr-demo/zephyr-course/zephyr/arch/arm/Kconfig"
osource "/home/sweekar/Projects/zephyr-demo/zephyr-course/zephyr/arch/arc/Kconfig"
```

## twister-out.1/stm32f4_disco_stm32f407xx/zephyr_gnu/tests/ring_buf/homework.unit.ring_buf/Kconfig/boards/Kconfig.sysbuild
```kconfig
# Load Sysbuild board Kconfig descriptions.
osource "/home/sweekar/Projects/zephyr-demo/zephyr-course/zephyr/boards/st/stm32f4_disco/Kconfig.sysbuild"
```

## twister-out.17/native_sim_native/host_gnu/tests/ring_buf/homework.unit.ring_buf/Kconfig/boards/Kconfig
```kconfig
# Load Zephyr board Kconfig descriptions.
osource "/home/sweekar/Projects/zephyr-demo/zephyr-course/zephyr/boards/native/native_sim/Kconfig"
```

## twister-out/native_sim_native/host_gnu/tests/ring_buf/homework.unit.ring_buf/Kconfig/boards/Kconfig.defconfig
```kconfig
# Load Zephyr board defconfig descriptions.
osource "/home/sweekar/Projects/zephyr-demo/zephyr-course/zephyr/boards/native/native_sim/Kconfig.defconfig"
```
